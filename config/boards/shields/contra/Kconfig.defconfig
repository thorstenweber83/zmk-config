## config/boards/shields/contra/Kconfig.defconfig
```kconfig
# Copyright (c) 2021 The ZMK Contributors
# SPDX-License-Identifier: MIT

if SHIELD_CONTRA

config ZMK_KEYBOARD_NAME
    default "Contra Keyboard"

endif

if ZMK_DISPLAY

config I2C
	default y

config SSD1306
	default y

endif # ZMK_DISPLAY
```
